## sdkconfig.defaults.esp32s3
```kconfig
# ESPClaw ESP32-S3 specific configuration
# Target: ESP32-S3 (N18R8) - 16MB Flash, 8MB Octal PSRAM

# Flash configuration
CONFIG_ESPTOOLPY_FLASHSIZE_16MB=y
CONFIG_ESPTOOLPY_FLASHFREQ_80M=y
CONFIG_ESPTOOLPY_FLASHMODE_DIO=y

# Performance optimization
CONFIG_COMPILER_OPTIMIZATION_PERF=y

# PSRAM - 8MB Octal
CONFIG_SPIRAM=y
CONFIG_SPIRAM_MODE_OCT=y
CONFIG_SPIRAM_USE_MALLOC=y
CONFIG_SPIRAM_MALLOC_ALWAYSINTERNAL=16384

# Larger TLS buffers (S3 has plenty of RAM)
CONFIG_MBEDTLS_SSL_IN_CONTENT_LEN=32768
CONFIG_MBEDTLS_SSL_OUT_CONTENT_LEN=16384

# Main task stack
CONFIG_ESP_MAIN_TASK_STACK_SIZE=16384

# Event task stack
CONFIG_ESP_SYSTEM_EVENT_TASK_STACK_SIZE=8192

# Partition table: 16MB with OTA
CONFIG_PARTITION_TABLE_CUSTOM_FILENAME="partitions_16mb.csv"
CONFIG_PARTITION_TABLE_CUSTOM=y

# Enable HTTP server
CONFIG_ESP_HTTPS_SERVER_ENABLE=y

# WiFi SoftAP support
CONFIG_ESP_WIFI_SOFTAP_SUPPORT=y

# Disable verbose logs
CONFIG_MBEDTLS_DEBUG=n
```

## sdkconfig.defaults.esp32s3_devkit
```kconfig
# ESPClaw for ESP32-S3 DevKit 1 (N16R8)
# Hardware: 16MB Flash + 8MB PSRAM
# Target: dual-core Xtensa LX7 @ 240MHz
# 
# Pinout Reference:
# - GPIO0-21: Digital I/O
# - GPIO0: Boot button
# - GPIO38-48: Analog inputs
# - USB-JTAG: GPIO19 (D-) / GPIO20 (D+)
# - SPI Flash: GPIO27-32

# Flash configuration (16MB)
CONFIG_ESPTOOLPY_FLASHSIZE_16MB=y
CONFIG_ESPTOOLPY_FLASHFREQ_80M=y

# Performance optimization
CONFIG_COMPILER_OPTIMIZATION_PERF=y

# PSRAM - Octal mode (8MB)
CONFIG_SPIRAM=y
CONFIG_SPIRAM_MODE_OCT=y
CONFIG_SPIRAM_USE_MALLOC=y
CONFIG_SPIRAM_MALLOC_ALWAYSINTERNAL=16384

# Memory buffers
CONFIG_MBEDTLS_SSL_IN_CONTENT_LEN=16384
CONFIG_MBEDTLS_SSL_OUT_CONTENT_LEN=16384
CONFIG_MBEDTLS_DYNAMIC_BUFFER=y

# Free up internal DRAM
CONFIG_SPIRAM_ALLOW_BSS_SEG_EXTERNAL_MEMORY=y
CONFIG_SPIRAM_RODATA=y
CONFIG_SPIRAM_TRY_ALLOCATE_WIFI_LWIP=y
CONFIG_SPIRAM_ALLOW_STACK_EXTERNAL_MEMORY=y
CONFIG_MBEDTLS_INTERNAL_MEM_ALLOC=n

# Task stacks (optimized to save DRAM)
CONFIG_ESP_MAIN_TASK_STACK_SIZE=8192
CONFIG_ESP_SYSTEM_EVENT_TASK_STACK_SIZE=4096

# Partition table: 16MB with OTA and LittleFS
CONFIG_PARTITION_TABLE_CUSTOM=y
CONFIG_PARTITION_TABLE_CUSTOM_FILENAME="partitions_16mb.csv"

# Enable HTTPS server
CONFIG_ESP_HTTPS_SERVER_ENABLE=y
CONFIG_HTTPD_MAX_REQ_HDR_LEN=2048
CONFIG_HTTPD_MAX_URI_LEN=1024

# Enable WiFi SoftAP support
CONFIG_ESP_WIFI_SOFTAP_SUPPORT=y
CONFIG_LWIP_IPV6=n
CONFIG_BT_ENABLED=n
CONFIG_OPENTHREAD_ENABLED=n
CONFIG_IEEE802154_ENABLED=n
CONFIG_ESP_COREDUMP_ENABLE=n
CONFIG_ESP_GDBSTUB_ENABLED=n
CONFIG_LOG_DEFAULT_LEVEL_WARN=y
CONFIG_LOG_DEFAULT_LEVEL=2
CONFIG_MBEDTLS_DEBUG=n
CONFIG_MBEDTLS_CERT_BUNDLE=y
CONFIG_MBEDTLS_CERT_BUNDLE_DEFAULT_FULL=y

# ESPClaw specific
CONFIG_ESPCLAW_WIFI_SSID=""
CONFIG_ESPCLAW_WIFI_PASSWORD=""
CONFIG_ESPCLAW_LLM_API_KEY=""
CONFIG_ESPCLAW_CHANNEL_MQTT=y
CONFIG_ESPCLAW_CHANNEL_TELEGRAM=y
CONFIG_ESPCLAW_MQTT_BROKER_URL="mqtts://e855d1adcb91498097194e25175017dd.s1.eu.hivemq.cloud"
```

## sdkconfig.defaults.esp32s3_tft_n16r8
```kconfig
# ESPClaw for ESP32-S3 N16R8 + 2.4" SPI TFT (ILI9341 240x320)
# Hardware: 16MB Flash + 8MB Octal PSRAM
# Display: SDI=11 SDO=13 SCK=12 CS=10 DC=9 RESET=8 LED=38
# Touch:  T_DIN/MOSI=11 T_DO/MISO=13 T_CLK/SCK=12 T_CS=14 T_IRQ=21

# Flash (16MB)
CONFIG_ESPTOOLPY_FLASHSIZE_16MB=y
CONFIG_ESPTOOLPY_FLASHFREQ_80M=y

CONFIG_COMPILER_OPTIMIZATION_PERF=y

# PSRAM Octal 8MB
CONFIG_SPIRAM=y
CONFIG_SPIRAM_MODE_OCT=y
CONFIG_SPIRAM_USE_MALLOC=y
CONFIG_SPIRAM_MALLOC_ALWAYSINTERNAL=16384
CONFIG_SPIRAM_ALLOW_BSS_SEG_EXTERNAL_MEMORY=y
CONFIG_SPIRAM_RODATA=y
CONFIG_SPIRAM_TRY_ALLOCATE_WIFI_LWIP=y
CONFIG_SPIRAM_ALLOW_STACK_EXTERNAL_MEMORY=y

CONFIG_MBEDTLS_SSL_IN_CONTENT_LEN=16384
CONFIG_MBEDTLS_SSL_OUT_CONTENT_LEN=16384
CONFIG_MBEDTLS_DYNAMIC_BUFFER=y
CONFIG_MBEDTLS_INTERNAL_MEM_ALLOC=n

CONFIG_ESP_MAIN_TASK_STACK_SIZE=8192
CONFIG_ESP_SYSTEM_EVENT_TASK_STACK_SIZE=4096

CONFIG_PARTITION_TABLE_CUSTOM=y
CONFIG_PARTITION_TABLE_CUSTOM_FILENAME="partitions_16mb.csv"

CONFIG_ESP_HTTPS_SERVER_ENABLE=y
CONFIG_HTTPD_MAX_REQ_HDR_LEN=2048
CONFIG_HTTPD_MAX_URI_LEN=1024

CONFIG_ESP_WIFI_SOFTAP_SUPPORT=y
CONFIG_LWIP_IPV6=n
CONFIG_BT_ENABLED=n
CONFIG_OPENTHREAD_ENABLED=n
CONFIG_IEEE802154_ENABLED=n
CONFIG_ESP_COREDUMP_ENABLE=n
CONFIG_ESP_GDBSTUB_ENABLED=n
CONFIG_LOG_DEFAULT_LEVEL_INFO=y
CONFIG_LOG_DEFAULT_LEVEL=3
CONFIG_MBEDTLS_CERT_BUNDLE=y
CONFIG_MBEDTLS_CERT_BUNDLE_DEFAULT_FULL=y

# ESPClaw: TFT display (not OLED)
CONFIG_ESPCLAW_DISPLAY_TFT=y
CONFIG_ESPCLAW_TFT_TOUCH_ENABLE=y
CONFIG_ESPCLAW_TFT_PIN_MOSI=11
CONFIG_ESPCLAW_TFT_PIN_MISO=13
CONFIG_ESPCLAW_TFT_PIN_SCK=12
CONFIG_ESPCLAW_TFT_PIN_CS=10
CONFIG_ESPCLAW_TFT_PIN_DC=9
CONFIG_ESPCLAW_TFT_PIN_RST=8
CONFIG_ESPCLAW_TFT_PIN_BL=38
CONFIG_ESPCLAW_TFT_PIN_T_CS=14
CONFIG_ESPCLAW_TFT_PIN_T_IRQ=21

CONFIG_ESPCLAW_WIFI_SSID=""
CONFIG_ESPCLAW_WIFI_PASSWORD=""
CONFIG_ESPCLAW_LLM_API_KEY=""
CONFIG_ESPCLAW_CHANNEL_MQTT=y
```
